## Documentation/devicetree/bindings/hwmon/aspeed-adc.txt
```
Bindings for ADC connected to the Aspeed 25xx ADC controller

Required properties:
- compatible	: "aspeed,aspeed2500-adc"
- reg		: ADC controller registers offset

Example:
	adc: adc@1e6e9000 {
		compatible = "aspeed,aspeed2500-adc";
		reg = <0x1e6e9000 0xc8>;
		clocks = <&clk_apb>;
		interrupts = <31>;
	};
```

## Documentation/devicetree/bindings/misc/aspeed,bt-device.txt
```
ASpeed AST2500 IPMI BT Device
-----------------------------------------------------
This binding defines the IPMI BT interface device found on ASpeed AST25xx SoC.

Required properties:
- compatible : "aspeed,bt-device"
- reg : Location and size of memory-mapped I/O BT registers.
- addr : The I/O port range to map the BT interface to.

Optional properties:
- interrupts - single interrupt.

Example:
	bt: bt-device@1e789000 {
		compatible = "aspeed,bt-device";
		reg = <0x1e789000 0x260>;
		interrupts = <8>;
		addr = <0x2702>;
	};
```

## Documentation/devicetree/bindings/mtd/aspeed-smc.txt
```
* Aspeed Static Memory controller
* Aspeed SPI Flash Controller

The Static memory controller in the ast2400 supports 5 chip selects each
can be attached to NAND, parallel NOR, or SPI NOR attached flash.  The
Firmware Memory Controller in the ast2500 supports 3 chip selects, two of
which are always in SPI-NOR mode and the third can be SPI-NOR or parallel
flash.  The SPI flash controller in the ast2400 supports one of 2 chip
selects selected by pinmux.  The two SPI flash controllers in the ast2500
each support two chip selects.

Required properties:
  - compatible : Should be one of
	"aspeed,ast2400-fmc" for the AST2400 Static Memory Controller
	"aspeed,ast2400-smc" for the AST2400 SPI Flash Controller
	"aspeed,ast2500-fmc" for the AST2500 Firmware SPI Memory Controller
	"aspeed,ast2500-smc" for the AST2500 SPI Flash Controllers
  - reg : the first contains the control register location and length,
          the second contains the memory window mapping address and length
  - clocks : The APB clock input to the controller
  - #address-cells : must be 1 corresponding to chip select child binding
  - #size-cells : must be 0 corresponding to chip select child binding

Optional properties:
  - aspeed,fmc-has-dma : controller supports DMA transfers
  - interrupts : Should contain the interrupt for the dma device if an fmc

Child node required properties:
  - reg : must contain chip select number in first cell of address, must
	  be 1 tuple long
  - compatible : may contain "vendor,part", must include "jedec,spi-nor"
		when attached to SPI flash (see spi-nor.txt binding).

Child node optional properties:
  - label           - (optional) name to assign to mtd, default os assigned

Child node optional properties for SPI mode (may be ignored):
  - spi-max-frequency - (optional) max frequency of spi bus
  - spi-cpol        - (optional) Empty property indicating device requires
			inverse clock polarity (CPOL) mode (boolean)
  - spi-cpha        - (optional) Empty property indicating device requires
			shifted clock phase (CPHA) mode (boolean)
  - spi-tx-bus-width - (optional) The bus width(number of data wires) that
                        used for MOSI. Defaults to 1 if not present.
  - spi-rx-bus-width - (optional) The bus width(number of data wires) that
                        used for MOSI. Defaults to 1 if not present.

Grandchild node optional properties:
 - see mtd/partiton.txt for partitioning bindings and mtd naming


Example:

fmc: fmc@1e620000 {
	compatible = "aspeed,ast2400-fmc";
	reg = < 0x1e620000 0x94
		0x20000000 0x02000000
		0x22000000 0x02000000 >;
	#address-cells = <1>;
	#size-cells = <0>;
	flash@0 {
		reg = < 0 >;
		compatible = "jedec,spi-nor" ;
		label = "bmc";
		/* spi-max-frequency = <>; */
		/* m25p,fast-read; */
		#address-cells = <1>;
		#size-cells = <1>;
		boot@0 {
			label = "boot-loader";
			reg = < 0 0x8000 >
		}
		image@8000 {
			label = "kernel-image";
			reg = < 0x8000 0x1f8000 >
		}
	};
	flash@1 {
		reg = < 1 >;
		compatible = "jedec,spi-nor" ;
		label = "alt";
		/* spi-max-frequency = <>; */
		status = "fail";
		/* m25p,fast-read; */
	};
};
```

## Documentation/devicetree/bindings/spi/spi-aspeed.txt
```
Device tree configuration for the generic Aspeed AST25XX SoC SPI controllers.

Required Properties:
	- #address-cells	: should be 1
	- #size-cells		: should be 0
	- compatible		: should be "aspeed,ast2500-spi"
	- reg			: address ranges for the control registers
				    and IO ports. There is one IO port window
				    for each chip select.
	- interrupts		: interrupt number

Example:

	spi1: spi@1e630000 {
		compatible = "aspeed,ast2500-spi";
		reg = <0x1e630000 0xc1 0x30000000 0x02000000 0x36000000 0x02000000>;
		interrupts = <59>;
		#address-cells = <1>;
		#size-cells = <0>;
		status = "disabled";
		flash@0 {
			reg = <0>; /* chip select number */
			compatible = "jedec,spi-nor";
			spi-max-frequency = <100000000>;
			status = "disabled";
		};
		flash@1 {
			reg = <1>; /* chip select number */
			compatible = "jedec,spi-nor";
			spi-max-frequency = <100000000>;
			status = "disabled";
		};
	};
```

## drivers/hwmon/aspeed/Kconfig
```kconfig
menu "ASPEED hwmon support"

config SENSORS_ASPEED_PWM_FAN
        tristate "ASPEED PWM & FAN Tacho Controller Driver"
        depends on ARCH_ASPEED
        default n
        help
          This driver provides support for the ASPEED PWM & FAN Tachometer
          Controller, which provides an Sensor, fan control.

config SENSORS_ASPEED_ADC
        tristate "ASPEED ADC Controller Driver"
        depends on ARCH_ASPEED
        default n
        help
          This driver provides support for the ASPEED ADC Controller.

endmenu
```

## linux/drivers/hwmon/mellanox/Kconfig
```kconfig
#
# Mellanox chip configuration
#

menuconfig MELLANOX
	tristate "Mellanox support"
	depends on I2C
	default n
	help
	  Say yes here for Mellanox hwmon support.


if MELLANOX

config MELLANOX_I2C_BACKEND
	tristate "Mellanox I2C backend"
	default y
	help
	  Say yes for Mellanox I2C backend driver support


config MELLANOX_ASIC_CORE
	tristate "Mellanox ASIC core"
	default y
	help
	  Say yes for Mellanox ASIC core support

config MELLANOX_ASIC_HWMON
	tristate "Mellanox ASIC hwmon"
	default y
	help
	  Say yes for Mellanox ASIC hwmon support

endif # MELLANOX
```

## linux/drivers/misc/aspeed/Kconfig
```kconfig
menu "ASPEED devices support"

config ASPEED_PECI
	tristate "Aspeed PECI driver"
	depends on I2C
	default n
	help
	  This option enables Aspeed PECI driver support.

	  If unsure, say N.

endmenu
```

## linux/drivers/pinctrl/aspeed/Kconfig
```kconfig
config PINCTRL_ASPEED_JTAG
	tristate "ASPEED JTAG control"
	default n
	help
	 Driver for ASPEED JTAG controller driver
```

## linux/drivers/usb/aspeed/Kconfig
```kconfig
#
# USB Host Controller Drivers
#
comment "ASPEED USB Drivers"
	depends on USB


config ASPEED_USB_UHCI_HCD
	tristate "ASPEED UHCI (USB 1.1) support"
	depends on USB
	---help---
	  The ASPEED Universal Host Controller Interface (UHCI) is standard for 
	  USB 1.1 host controller hardware. It is an embedded HC based on AMBA bus.
	  You may want to read <file:Documentation/usb/uhci.txt>.

	  To compile this driver as a module, choose M here: the
	  module will be called uhci-hcd.

choice
	prompt "Config ASPEED USB UHCI Number of Ports"
	depends on ASPEED_USB_UHCI_HCD

	config ASPEED_USB_UHCI_1_PORT
		bool "ASPEED UHCI support 1 ports"

	config ASPEED_USB_UHCI_2_PORT
		bool "ASPEED UHCI support 2 ports"

	config ASPEED_USB_UHCI_4_PORT
		bool "ASPEED UHCI support 4 ports"

endchoice
```
